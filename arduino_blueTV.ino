/*
  Arduino引脚蓝牙引脚
  RX（引脚0）----> TX
  TX（引脚1）----> RX
  5V ----> VCC
  GND ----> GND
  Arduino引脚OLED0.96引脚
  SDA（引脚0）----> A4
  SCL（引脚1）----> A5
  5V ----> VCC
  GND ----> GND
*/
// 引入IIC通讯所需的Wire库文件
#include <Wire.h>
// 引入驱动OLED0.96所需的库
#include <Adafruit_GFX.h>
#include <Adafruit_SSD1306.h>
// 设置OLED宽度/高度,单位:像素
#define SCREEN_WIDTH 128
#define SCREEN_HEIGHT 64
#define BYTE_UNIT_LENGTH 8
// 自定义重置引脚, Adafruit_SSD1306库文件所必需
#define OLED_RESET 4
// bluethood read bytes length
#define READ_BYTE_LENGTH  9
// bluethood vcc time
#define MAX_LOOP_TIME 180000
#define BLUETHOOD_VCC_PIN A2
// read bytes temp data store
String rsbuf;
// open logo icon
const unsigned char LOGO_PIXELS [] PROGMEM = {
  0xf8, 0xff, 0xff, 0xff, 0xff, 0xff, 0xff, 0xff, 0xff, 0xff, 0xff, 0xff, 0xff, 0xff, 0xff, 0xff,
  0xff, 0xff, 0xff, 0xff, 0xff, 0xff, 0xff, 0xff, 0xff, 0xff, 0xff, 0xff, 0xff, 0xff, 0xff, 0xff,
  0xff, 0xff, 0xff, 0xff, 0xff, 0xff, 0xff, 0xff, 0xff, 0xff, 0xff, 0xff, 0xff, 0xff, 0xff, 0xff,
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  0xff, 0xff, 0xff, 0xff, 0xff, 0xff, 0xff, 0xff, 0xff, 0xff, 0xff, 0xff, 0xff, 0xff, 0xff, 0xff
};
// init display
Adafruit_SSD1306 display(SCREEN_WIDTH, SCREEN_HEIGHT, &Wire, OLED_RESET);

void init_display()
{
  // 初始化OLED并设置其IIC地址为 0x3C
  // SSD1306_SWITCHCAPVCC = generate display voltage from 3.3V internally
  display.begin(SSD1306_SWITCHCAPVCC, 0x3C);
  // 清除屏幕
  display.clearDisplay();
  // Display bitmap
  display.drawBitmap(0, 0,  LOGO_PIXELS, SCREEN_WIDTH, SCREEN_HEIGHT, WHITE);
  // display
  display.display();
}

void init_bluethood_vcc() {
  pinMode(BLUETHOOD_VCC_PIN, OUTPUT);
  // init high bluethood
  digitalWrite(BLUETHOOD_VCC_PIN, HIGH);
}

void setup()
{
  // Serial1 Serial
  Serial1.begin(9600);
  init_display();
  init_bluethood_vcc();
}

void switchMethod(String _s) {
  char methodSep = '|';
  char dataSep = '-';
  int _s_length = _s.length();
  int methodSepIndex = -1;
  int dataSepIndex = -1;
  // for save func name
  String method;
  // for byte params
  byte rbuf[READ_BYTE_LENGTH];
  // for print text
  String dataStr;
  // _s => `method|byte-data`
  for (int i = 0, j = 0; i < _s_length ; i++) {
    char current = _s.charAt(i);
    if (current == methodSep) {
      methodSepIndex = i;
      continue;
    }
    if (current == dataSep) {
      dataSepIndex = i;
      continue;
    }
    if (methodSepIndex == -1) {
      method += current;
    }
    if (methodSepIndex != -1 && methodSepIndex != i && dataSepIndex == -1) {
      rbuf[j++] = current;
    }
    if(dataSepIndex != -1 && dataSepIndex != i){
      dataStr += current;
    }
  }
  if (method == "println") {
    display.setTextSize(rbuf[0]);
    display.setTextColor(WHITE);
    display.setCursor(rbuf[1], rbuf[2]);
    display.println(dataStr);
    return display.display();
  }
  if (method == "startscrollleft") {
    return display.startscrollleft(rbuf[0], rbuf[1]);
  }
  if (method == "startscrolldiagleft") {
    return display.startscrolldiagleft(rbuf[0], rbuf[1]);
  }
  if (method == "startscrollright") {
    return display.startscrollright(rbuf[0], rbuf[1]);
  }
  if (method == "startscrolldiagright") {
    return display.startscrolldiagright(rbuf[0], rbuf[1]);
  }
  if (method == "stopscroll") {
    return display.stopscroll();
  }
  if (method == "clearDisplay") {
    display.clearDisplay();
    return display.display();
  }
  if (method == "drawBitmap") {
    int count = int(rbuf[0]) * (READ_BYTE_LENGTH - 1) * BYTE_UNIT_LENGTH;
    int x = count % SCREEN_WIDTH;
    int y = count / SCREEN_WIDTH;
    unsigned char bitmapBuf[READ_BYTE_LENGTH - 1];
    for (int i = 1; i < READ_BYTE_LENGTH; i++)
    {
      bitmapBuf[i - 1] = (char)rbuf[i];
    }
    display.drawBitmap(x, y, bitmapBuf, BYTE_UNIT_LENGTH * BYTE_UNIT_LENGTH, 1, WHITE);
    return display.display();
  }
}

void loop()
{
  if (Serial1.available() > 0)     // 仅在收到数据时
  {
    rsbuf = "";
    rsbuf = Serial1.readString();
    switchMethod(rsbuf);
  }
}
